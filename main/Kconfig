## main/Kconfig
```kconfig
menu "HiLily Configuration"

    config HILILY_QEMU_MODE
        bool "Enable QEMU emulation mode"
        default n
        help
            When enabled, hardware peripherals (I2S, SPI LCD, GPIO, LEDC, WiFi)
            are replaced with mock implementations for QEMU testing.
            A UART test console is enabled for simulating button presses,
            audio injection, and state inspection.

    config HILILY_QEMU_MOCK_WIFI_CONNECTED
        bool "Mock WiFi as always connected"
        default y
        depends on HILILY_QEMU_MODE
        help
            Simulate WiFi as always connected in QEMU mode.

    config HILILY_QEMU_MOCK_BATTERY_PERCENT
        int "Mock battery percentage"
        default 85
        range 0 100
        depends on HILILY_QEMU_MODE
        help
            Fixed battery percentage to report in QEMU mode.

endmenu
```

## sdkconfig.defaults
```kconfig
# ESP32-S3 配置
CONFIG_IDF_TARGET="esp32s3"

# Flash 配置
CONFIG_ESPTOOLPY_FLASHSIZE_16MB=y
CONFIG_ESPTOOLPY_FLASHMODE_QIO=y

# CPU 频率
CONFIG_ESP_DEFAULT_CPU_FREQ_MHZ_240=y

# SPIRAM (PSRAM) 配置
CONFIG_SPIRAM=y
CONFIG_SPIRAM_MODE_OCT=y
CONFIG_SPIRAM_SPEED_80M=y

# mbedTLS 内存: 使用默认分配器 (自动使用 PSRAM)
CONFIG_MBEDTLS_DEFAULT_MEM_ALLOC=y

# 分区表
CONFIG_PARTITION_TABLE_CUSTOM=y
CONFIG_PARTITION_TABLE_CUSTOM_FILENAME="partitions.csv"
CONFIG_PARTITION_TABLE_FILENAME="partitions.csv"

# 编译优化
CONFIG_COMPILER_OPTIMIZATION_PERF=y

# C++ 异常和 RTTI
CONFIG_COMPILER_CXX_EXCEPTIONS=y
CONFIG_COMPILER_CXX_RTTI=y

# 日志级别
CONFIG_LOG_DEFAULT_LEVEL_INFO=y

# WiFi
CONFIG_ESP_WIFI_IRAM_OPT=n
CONFIG_ESP_WIFI_RX_IRAM_OPT=n

# FreeRTOS
CONFIG_FREERTOS_HZ=1000
CONFIG_FREERTOS_ISR_STACKSIZE=2048

# 主任务栈大小
CONFIG_ESP_MAIN_TASK_STACK_SIZE=16384

# LVGL (禁用不需要的控件)
CONFIG_LV_USE_CHART=n
CONFIG_LV_USE_KEYBOARD=n
CONFIG_LV_USE_MENU=n
CONFIG_LV_USE_MSGBOX=n

# ESP-SR 语音识别
CONFIG_MODEL_IN_SPIFFS=y
CONFIG_SR_NSN_NSNET2=y

# OTA
CONFIG_BOOTLOADER_APP_ROLLBACK_ENABLE=y

# Ensure hardware builds do not use QEMU mock components
# CONFIG_HILILY_QEMU_MODE is not set
```
